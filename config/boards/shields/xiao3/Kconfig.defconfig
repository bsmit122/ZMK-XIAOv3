## config/boards/shields/xiao3/Kconfig.defconfig
```kconfig
####################################################
if SHIELD_XIAO3_LEFT || SHIELD_XIAO3_RIGHT

config ZMK_SPLIT
    default y

config ZMK_SLEEP
    default y

config SPI
    default y

config ZMK_RGB_UNDERGLOW_EXT_POWER
    default n

config ZMK_KSCAN_MATRIX_WAIT_BEFORE_INPUTS
    default 0

config ZMK_KSCAN_MATRIX_WAIT_BETWEEN_OUTPUTS
    default 1
    
endif

####################################################
if SHIELD_DONGLE

# Max 16 characters in keyboard name
config ZMK_KEYBOARD_NAME
    default "ZMK Cosmos"

config ZMK_SPLIT_ROLE_CENTRAL
    default y

config ZMK_SPLIT
    default y

config ZMK_SPLIT_BLE_CENTRAL_PERIPHERALS
    default 2

config BT_MAX_CONN
    default 6

# Set this to the same number as BT_MAX_CONN
config BT_MAX_PAIRED
    default 6

config ZMK_RGB_UNDERGLOW_EXT_POWER
    default n

endif

####################################################
config ZMK_RGB_UNDERGLOW
    default y
    imply WS2812_STRIP
```

## config/boards/shields/xiao3/Kconfig.shield
```kconfig
config SHIELD_XIAO3_LEFT
    def_bool $(shields_list_contains,xiao3_left)

config SHIELD_XIAO3_RIGHT
    def_bool $(shields_list_contains,xiao3_right)

# No whitespace after the comma or in the keyboard name!
config SHIELD_DONGLE
    def_bool $(shields_list_contains,dongle)
```
